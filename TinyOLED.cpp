/* TinyOLED v0.0.1

   Sebastian Murgul - www.sebastian-murgul.com - 29th June 2022
   
   CC BY 4.0
   Licensed under a Creative Commons Attribution 4.0 International license: 
   http://creativecommons.org/licenses/by/4.0/
*/

#include "TinyOLED.h"
#include "TinyI2CMaster.h"

// OLED init settings
const uint8_t OLED_INIT_CMD[] = {  
  0xA8, 0x1F,       // set multiplex (HEIGHT-1): 0x1F for 128x32, 0x3F for 128x64 
  0x22, 0x00, 0x03, // set min and max page
  0x20, 0x00,       // set horizontal memory addressing mode
  0xDA, 0x02,       // set COM pins hardware configuration to sequential
  0x8D, 0x14,       // enable charge pump
  0xAF,             // switch on OLED
  0xA1, 0xC8        // flip the screen
};

// standard ASCII 5x8 font (adapted from Neven Boyanov and Stephen Denne)
const uint8_t OLED_FONT[] = {
  0x00, 0x00, 0x00, 0x00, 0x00, //   0 
  0x00, 0x00, 0x2f, 0x00, 0x00, // ! 1 
  0x00, 0x07, 0x00, 0x07, 0x00, // " 2 
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  0x40, 0x40, 0x40, 0x40, 0x40  // _ 63
};

TinyOLED::TinyOLED() {
  
}

void TinyOLED::init(void) {
  TinyI2C.init();                          // initialize I2C first
  TinyI2C.start(OLED_ADDR, 0);             // start transmission to OLED
  TinyI2C.write(OLED_CMD_MODE);            // set command mode
  for (uint8_t i = 0; i < OLED_INIT_LEN; i++) 
    TinyI2C.write(OLED_INIT_CMD[i]);
  TinyI2C.stop();                          // stop transmission
}

// OLED clear screen
void TinyOLED::clear(void) {  
  TinyI2C.start(OLED_ADDR, 0);             // start transmission to OLED
  TinyI2C.write(OLED_CMD_MODE);            // set command mode
  TinyI2C.write(0x40 | (0 & 0X3F));        // SSD1306_SETSTARTLINE 
  TinyI2C.stop();                          // stop transmission

  for (uint8_t r = 0; r < 32; r++) {
    TinyOLED::cursor(0, r);                // set cursor at upper left corner
    for (uint8_t c = 0; c < 128; c++) {
      TinyI2C.start(OLED_ADDR, 0);         // start transmission to OLED
      TinyI2C.write(OLED_DAT_MODE);        // set data mode
      TinyI2C.write(0x00);                 // clear the screen
      TinyI2C.stop();                      // stop transmission
    }
  }
  
  TinyOLED::shift(0);                      // reset vertical shift
}

// OLED set vertical shift
void TinyOLED::shift(uint8_t ypos) {
  TinyI2C.start(OLED_ADDR, 0);             // start transmission to OLED
  TinyI2C.write(OLED_CMD_MODE);            // set command mode
  TinyI2C.write(0xD3);                     // vertical shift command
  TinyI2C.write(ypos);                     // set vertical shift value
  TinyI2C.stop();                          // stop transmission
}

// OLED print a character
void TinyOLED::printChar(char ch) {
  uint16_t offset = ch - 32;               // calculate position of character in font array
  offset += offset << 2;                   // -> offset = (ch - 32) * 5
  TinyI2C.start(OLED_ADDR, 0);             // start transmission to OLED
  TinyI2C.write(OLED_DAT_MODE);            // set data mode
  TinyI2C.write(0x00);                     // print spacing between characters
  for(uint8_t i=5; i; i--) 
    TinyI2C.write(OLED_FONT[offset++]);    // print character
  TinyI2C.stop();                          // stop transmission
}

// OLED print a string from program memory
void TinyOLED::printStr(const char* p) {
  while(*p) TinyOLED::printChar(*p++);
}

// OLED set the cursor
void TinyOLED::cursor(uint8_t xpos, uint8_t ypos) {
  TinyI2C.start(OLED_ADDR, 0);             // start transmission to OLED
  TinyI2C.write(OLED_CMD_MODE);            // set command mode
  TinyI2C.write(xpos & 0x0F);              // set low nibble of start column
  TinyI2C.write(0x10 | (xpos >> 4));       // set high nibble of start column
  TinyI2C.write(0xB0 | (ypos & 0x07));     // set start page
  TinyI2C.stop();                          // stop transmission
}
